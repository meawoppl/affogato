/**
 * {{PROJECT_NAME}} - Main Application
 * Generated by Affogato
 */

#include <stdio.h>
#include "freertos/FreeRTOS.h"
#include "freertos/task.h"
#include "esp_log.h"

#include "ice40.h"

static const char *TAG = "main";

// FPGA bitstream embedded by CMake target_add_binary_data
extern const uint8_t _binary_top_bin_start[];
extern const uint8_t _binary_top_bin_end[];

static const fpga_bin_t fpga_image = {
    .start = _binary_top_bin_start,
    .end = _binary_top_bin_end,
};

void app_main(void)
{
    ESP_LOGI(TAG, "{{PROJECT_NAME}} starting");

    // Initialize SPI bus
    esp_err_t ret = master_spi_init();
    if (ret != ESP_OK) {
        ESP_LOGE(TAG, "SPI init failed: %s", esp_err_to_name(ret));
        return;
    }

    // Initialize FPGA loader
    ret = fpga_loader_init();
    if (ret != ESP_OK) {
        ESP_LOGE(TAG, "FPGA loader init failed: %s", esp_err_to_name(ret));
        return;
    }

    // Load FPGA bitstream
    ret = fpga_loader_load_from_rom(&fpga_image);
    if (ret != ESP_OK) {
        ESP_LOGE(TAG, "FPGA load failed: %s", esp_err_to_name(ret));
        return;
    }

    ESP_LOGI(TAG, "FPGA loaded successfully");

    // TODO: Add your application-specific SPI communication here
    // Example: Initialize your fpga_comms module

    // Main loop
    while (1) {
        ESP_LOGI(TAG, "Heartbeat");
        vTaskDelay(pdMS_TO_TICKS(1000));
    }
}
